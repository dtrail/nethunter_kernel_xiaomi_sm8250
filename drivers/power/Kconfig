## drivers/power/Kconfig
```kconfig
source "drivers/power/avs/Kconfig"
source "drivers/power/reset/Kconfig"
source "drivers/power/supply/Kconfig"
config POWERSAFE_TOGGLE
	bool "Enable powersafe toggle module"
	default y
	help
	    Runtime toggles for CPU latency, PRIME frequency and I/O weighting.
```

## drivers/staging/rtl8188eu/Kconfig
```kconfig
config RTL8198EU
	tristate "Realtek 8192E USB WiFi"
	depends on USB
	---help---
	  Help message of RTL8192EU
```
